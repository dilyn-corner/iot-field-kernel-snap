## sl1640/fit-image/fitImage_arm64.its
```
/*
 * U-Boot uImage source file for the <platform>
 * Note that 'data' paths are relative to the current working directory where
 * mkimage is invoked in the fit-image part!
 * It's most convenient if all the relevant blobs are in the stage/ directory.
 * This is just some minimum viable example; see the official documentation:
 * https://doc.coreboot.org/lib/payloads/fit.html
 * Please update any <info> or ${variables} as needed!
 */

/dts-v1/;

/ {
	description = "Ubuntu Core kernel, ramdisk, and FDT blob for <platform>";
	#address-cells = <1>;

	images {
		kernel {
			description = "Ubuntu Kernel";
			data = /incbin/("kernel.img");
			type = "kernel";
			arch = "arm64";
			os = "linux";
			compression = "none";
			load =  <0x07c00000>;
			entry = <0x07c00000>;
			hash {
				algo = "sha256";
			};
		};
		ramdisk {
			description = "Ubuntu Core ramdisk";
			data = /incbin/("initrd.img");
			type = "ramdisk";
			arch = "arm64";
			os = "linux";
			compression = "none";
			load =  <0x07d00000>;
			hash {
				algo = "sha256";
			};
		};
		platypus-rdk.dtb {
			description = "<platform> DTB";
			data = /incbin/("dtbs/synaptics/platypus-rdk.dtb");
			type = "flat_dt";
			arch = "arm64";
			compression = "none";
			load =  <0x047f6000>;
			hash {
				algo = "sha256";
			};
		};
	};
	configurations {
		default = "platypus-rdk";
		platypus-rdk {
			description = "Synaptics SL1640";
			kernel = "kernel";
			ramdisk = "ramdisk";
			fdt = "platypus-rdk.dtb";
			hash {
				algo = "sha256";
			};
		};
	};
};
```
